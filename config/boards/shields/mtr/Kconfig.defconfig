## config/boards/shields/mtr/Kconfig.defconfig
```kconfig
/*
 * Copyright (c) 2023 mentako-ya
 *
 * SPDX-License-Identifier: MIT
 */

if SHIELD_MTR

config ZMK_KEYBOARD_NAME
    default "mtr"

endif
```

## config/boards/shields/mtr/Kconfig.shield
```kconfig
/*
 * Copyright (c) 2023 mentako-ya
 *
 * SPDX-License-Identifier: MIT
 */

config SHIELD_MTR
    def_bool $(shields_list_contains,mtr)
```
